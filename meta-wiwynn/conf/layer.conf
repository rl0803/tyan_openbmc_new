## meta-wiwynn/conf/layer.conf
```bitbake
# We have a conf and classes directory, add to BBPATH
BBPATH .= ":${LAYERDIR}"

# We have recipes-* directories, add to BBFILES
BBFILES += "${LAYERDIR}/meta-common/recipes-*/*/*.bb \
            ${LAYERDIR}/meta-common/recipes-*/*/*.bbappend"

BBFILE_COLLECTIONS += "wiwynn"
BBFILE_PATTERN_wiwynn := "^${LAYERDIR}/"

LAYERVERSION_wiwynn-layer = "1"
LAYERSERIES_COMPAT_wiwynn = "thud warrior"

# Provide a variable that points the base of the wiwynn layer.
WIWBASE = '${@os.path.normpath("${LAYERDIR}/")}'
```

## meta-wiwynn/meta-sv300g3e/conf/machine/sv300g3e.conf
```bitbake
KMACHINE = "aspeed"
KERNEL_DEVICETREE = "${KMACHINE}-bmc-wiwynn-${MACHINE}.dtb"

require conf/machine/include/ast2500.inc
require conf/machine/include/obmc-bsp-common.inc
require conf/machine/include/wiwynn.inc

UBOOT_MACHINE = "ast_g5_phy_config"

FLASH_SIZE = "32768"

VIRTUAL-RUNTIME_skeleton_workbook = "${MACHINE}-config"

PREFERRED_PROVIDER_virtual/phosphor-led-manager-config-native ?= "sv300g3e-led-manager-config-native"

# PREFERRED_PROVIDER_virtual/obmc-host-ctl ?= "obmc-op-control-host"
PREFERRED_PROVIDER_virtual/obmc-host-ctl = "packagegroup-wiwynn-apps"
PREFERRED_PROVIDER_virtual/obmc-host-ipmi-hw = "phosphor-ipmi-kcs"
PREFERRED_PROVIDER_virtual/obmc-gpio-monitor = "phosphor-gpio-monitor"
```
